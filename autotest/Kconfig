## autotest/Kconfig
```kconfig
# SPDX-FileCopyrightText: 2023-2024 Ledger SAS
# SPDX-License-Identifier: Apache-2.0

if BUILD_TARGET_AUTOTEST

menu "Autotest configuration"

choice
    bool "Test application implementation"
    default AUTOTEST_C

    config AUTOTEST_C
    bool "C11 test application using the FFI-C UAPI interface"

    config AUTOTEST_RUST
    bool "Rust test application using the native Rust UAPI interface"

endchoice

config TEST_SYSCALL_FUZZ
        bool "Syscall fuzzing campaign (runtime)"
        default n
        help
            Enable a syscall-oriented fuzzing campaign executed from autotest.
            This campaign primarily targets the SVC interface and IPC length
            transitions to surface risky runtime behaviors.

config TEST_SYSCALL_FUZZ_ITERS
        int "Number of syscall fuzzing iterations"
        range 16 4096
        default 512
        depends on TEST_SYSCALL_FUZZ
        help
            Number of iterations for the main syscall fuzzing campaign.

if !TEST_SYSCALL_FUZZ

config AUTOTEST_TIMER_DRIVER
    bool
    default n

config TEST_YIELD
    bool "yield test suite"
    default y

config TEST_HANDLES
    bool "handles access test suite"
    default y

config TEST_SIGNALS
    bool "Signal snd/receive test suite"
    default y

config TEST_IPC
    bool "IPC snd/receive test suite"
    default y

config TEST_RANDOM
    bool "KRNG test suite"
    default y

config TEST_CYCLES
    bool "Cycle measurement test suite"
    default y

config TEST_SLEEP
    bool "Various slepping mode test suite"
    default y

config TEST_GPIO
    bool "GPIO kernel API test suite"
    default n

config TEST_DEVICES
    bool "devices (un)mapping and access API test suite"
    default n

config TEST_SHM
    bool "Shared memory manipulation test suite"
    default y

config TEST_DMA
    bool "Direct Memory Access test suite"
    select TEST_SHM
    default n

config TEST_IRQ
    bool "User interrupts test suite, need timer support at autotest level"
    select AUTOTEST_TIMER_DRIVER
    default n

config TEST_CAPA
    bool "Test that userspace capabilities are properly triggered by the kernel"
    default n

endif

endmenu

endif
```

## configs/nucleo_u5a5_autotest_framac_defconfig
```kconfig
# SPDX-FileCopyrightText: 2023-2024 Ledger SAS
# SPDX-License-Identifier: Apache-2.0

CONFIG_ARCH_MCU_STM32U5A5=y
CONFIG_FPU_SOFTFP_ABI=y
CONFIG_STANDALONE_MODE=y
CONFIG_BUILD_TARGET_AUTOTEST=y
CONFIG_TEST_GPIO=y
CONFIG_TEST_DEVICES=y
CONFIG_TEST_DMA=y
CONFIG_TEST_IRQ=y
CONFIG_TEST_CAPA=y
CONFIG_DEBUG_LEVEL=0
# CONFIG_DEBUG_LOGO is not set
```

## configs/nucleo_u5a5_autotest_fuzzer_defconfig
```kconfig
# SPDX-FileCopyrightText: 2026 H2Lab OSS Team
# SPDX-License-Identifier: Apache-2.0

CONFIG_ARCH_MCU_STM32U5A5=y
CONFIG_FPU_SOFTFP_ABI=y
CONFIG_STANDALONE_MODE=y
CONFIG_BUILD_TARGET_AUTOTEST=y
CONFIG_TEST_SYSCALL_FUZZ=y
CONFIG_TEST_SYSCALL_FUZZ_ITERS=512
```

## configs/nucleo_u5a5_nooutput_defconfig
```kconfig
# SPDX-FileCopyrightText: 2023-2024 Ledger SAS
# SPDX-License-Identifier: Apache-2.0

CONFIG_ARCH_MCU_STM32U5A5=y
CONFIG_FPU_SOFTFP_ABI=y
CONFIG_DEBUG_OUTPUT_NONE=y
CONFIG_STANDALONE_MODE=y
CONFIG_SECU_METADATA_SHA256_CHECK=y
```

## configs/nucleo_wb55_autotest_defconfig
```kconfig
# SPDX-FileCopyrightText: 2025 Ledger SAS
# SPDX-License-Identifier: Apache-2.0

CONFIG_ARCH_MCU_STM32WB55_CM4=y
CONFIG_DRV_STM32_LPUART=y
CONFIG_STANDALONE_MODE=y
CONFIG_BUILD_TARGET_AUTOTEST=y
CONFIG_TEST_CAPA=y
# CONFIG_TEST_SHM is not set
```

## configs/qemu_rv32im_defconfig
```kconfig
# SPDX-FileCopyrightText: 2025 ANSSI
# SPDX-License-Identifier: Apache-2.0

CONFIG_STANDALONE_MODE=y
CONFIG_ARCH_RISCV=y
CONFIG_ARCH_RV32=y
CONFIG_RUSTC_TARGET="riscv32imc-unknown-none-elf"
```

## configs/stm32f429i_disc1_autotest_defconfig
```kconfig
# SPDX-FileCopyrightText: 2023-2024 Ledger SAS
# SPDX-License-Identifier: Apache-2.0

CONFIG_ARCH_MCU_STM32F429=y
CONFIG_STANDALONE_MODE=y
CONFIG_BUILD_TARGET_AUTOTEST=y
CONFIG_TEST_IRQ=y
CONFIG_TEST_CAPA=y
```

## configs/stm32h573i_dk_defconfig
```kconfig
# SPDX-FileCopyrightText: 2025 ANSSI
# SPDX-License-Identifier: Apache-2.0

CONFIG_ARCH_MCU_STM32H573=y
CONFIG_FPU_SOFTFP_ABI=y
CONFIG_DRV_STM32_LPUART=y
CONFIG_STANDALONE_MODE=y
```

## kernel/Kconfig
```kconfig
# SPDX-FileCopyrightText: 2023-2024 Ledger SAS
# SPDX-License-Identifier: Apache-2.0

rsource 'src/arch/Kconfig'
rsource 'src/drivers/Kconfig'
rsource 'src/startup/Kconfig'
rsource 'src/managers/Kconfig'

menu "Build mode"

config STANDALONE_MODE
	bool "Standalone mode"
	help
	  Allows standalone mode. No external task is built, Sentry only
	  execute itself and its own services and platform init.
	  Useful for basic platform debug and testing and architecture port

# debug relative options. Only set through build type. For security relative
# see src/security/Kconfig
config BUILD_WITH_GDB
	bool


choice
	bool "Build type"
config BUILD_TARGET_DEBUG
	bool "Build in debug mode"
	help
	  Allows ggdb support, debug options, disable hardening and optimisation that
	  may br ptoblematic for debugging purpose.
	  MUST NOT BE USED FOR DELIVERY.
	select BUILD_WITH_GDB

config BUILD_TARGET_RELEASE
	bool "Build in release mode"
	help
	  Remove all debugging-relative flags, activate all hardening mechanisms
	select SECU_SSP_USER
	select SECU_SSP_KERN
	select SECU_HW_SETNCHECK
	select SECU_NO_COMPTOZERO
	select SECU_LOOP_DBLE_IDX

config BUILD_TARGET_AUTOTEST
	bool "Built Sentry in autotest mode"
	help
	  Build autotest task and activate kernel autotest flag. The kernel
	  do no more parse the task metadata table but instead load the autotest
	  app and enable autotest mode in managers and syscalls kernel-side.
	  This allows a lot of runtime-testing, that can be controlled through
	  a dedicated, autotest-enabled specific syscall used by the autotest app,
	  that can be triggered through a serial communication with a CI or a test PC
	  to generate Sentry test reports.
	select SECU_SSP_USER
	select SECU_SSP_KERN
	select SECU_HW_SETNCHECK
	select SECU_NO_COMPTOZERO
	select SECU_LOOP_DBLE_IDX
endchoice

config EXPERIMENTAL_MODE
    bool
    default n

config WITH_SMP_SUPPORT
    bool "Support for SMP architecture (EXPERIMENTAL)"
    default n
    help
      In SMP mode, the kernel can be spawned in parallel in multiple cores at the
      same time. As a consequence:
      - the initialization is differenciated between core 0 and other cores, core 0
        being responsible for the initialisation of system-wide data (e.g. task listing)
      - depending on the selected scheduling policy, task (or jobs) are assigned to cores.
        All task being single threaded, there is no parallelism constraint at task level,
        their core-assignation being dependent of the selected scheduler
      - all kernel code after bootup must be reentrant, using hardware SMP-related locks
        if needed for system-wide impacting codes (e.g. using spin locking)
    select EXPERIMENTAL_MODE

if WITH_SMP_SUPPORT


config SMP_CORES_NUMBER
    int "number of SMP cores"
    default 1
    help
      Define the number of cores in the SMP architecture.
      Such an information is required in order to dimension some data (e.g. scheduling backend
      when using per-core scheduling FIFO) and also permits to automatically hang any core being
      out of the cores range (e.g. if this config is set to 2, but 3 cores are started at bootup,
      the kernel init sequence will automatically hold forever on third core)

endif

config WITH_UF2
	bool "Build Sentry as UF2 image"
	default n
	help
	  Build Sentry as a UF2 image, that can be flashed on a Raspberry Pi Pico or
	  other compatible devices. This is useful for development and testing purposes.
	  The resulting file will be named `sentry-kernel.uf2` in the build directory.


config WITH_JTAG_CONNECTED
	bool "Built for target with JTAG connected, active auto-breakpoints"
	default n
	depends on BUILD_TARGET_DEBUG || BUILD_TARGET_AUTOTEST

endmenu

menu "Kernel security"

# symbols selected by build mode
config SECU_SSP_USER
	bool
	# support for user threads stack canaries

config SECU_SSP_KERN
	bool
	# support for kernel threads stack canaries

config SECU_ENABLE_EACSL
	bool "Enable e-ACSL runtime assertion in kernel build"
	---help---
	  For subcomponents that hold EVA+WP ACSL annotations, add memory and pointer
	  runtime assertions generated by e-acsl, based on statically-analyzed assertion.
	  In nominal (non-faulted) states, they have been proven as valid, but the generated
	  assertions delivers runtime check agaisnt faults injection.
	default n

config SECU_HW_SETNCHECK
	bool
	---help---
	  when possible (may depend on the hardware device), double verify that
	  the target register configuration is valid and active
	# Unable set and check of critical hardware registers
	# (iowrite + ioread and compare)

config SECU_NO_WEAKTYPES
	bool
	---help---
	  Comparison to 0 lead to potential weak optimizations that should be
	  avoided in security critical environment. In the same way, hamming distance
	  of 1 can be easily faulted, in comparison with a discrete type.
	  This is done by using secure_bool_t type and by activating (gcc>=14)

config SECU_TASK_INTEGRITY_AT_BOOT
	bool

config SECU_ENFORCE_COMPARE
	bool "Enforce comparison checks by compiler"
	default y
	---help---
	  All variable comparison and conditional branch related comparison are
	  hardened using the `harden-compares` and `harden-conditional-branches`
	  hardening flags (gcc>=13)

config SECU_ENFORCE_CFI
	bool "Harden control flow redundancy"
	default n
	---help---
	  Emit extra code to set booleans when entering basic blocks, and to verify
	  and trap, at function exits, when the booleans do not form an execution
	  path that is compatible with the control flow graph.

config SECU_ENFORCE_RETURNING_CALLS
	depends on SECU_ENFORCE_CFI
	default y
	bool "Enforce return-time control flow"
	---help---
	  Harden return time checks, including noreturn invalid behavior, using
	  -fhardcfr-check-returning-calls and -fhardcfr-check-noreturn-calls=always flags
	  (gcc>=14)

config SECU_ENFORCE_FAULT_INJECTION
	bool "Enforce fault injection projections"
	---help---
	  Enable this flag to enforce formally proven execution
	  paths with supplementary checks that whould have been dead
	  code in nominal execution

config SECU_RESET_ON_USERFAULT
	bool "Reset system on userspace fault"
	default n
	---help---
	  If any user-space task generates a fault (e.g. invalid memory access,
	  illegal instruction, division by zero, etc), the whole system is reset for
	  security purposes.
	  Note that this may lead to denial of service if a faulty task is
	  continuously executed. In the same time, it would avoid potential
	  exploitation of such faults to escalate privileges or to leak
	  sensitive data.

endmenu
```

## kernel/src/arch/Kconfig
```kconfig
# SPDX-FileCopyrightText: 2023-2024 Ledger SAS
# SPDX-FileCopyrightText: 2025 ANSSI
# SPDX-License-Identifier: Apache-2.0

menu "Platform support"

config ARCH_ARM
	bool

config ARCH_RISCV
	bool

choice
	prompt "Target arch selection"

config ARCH_ARM_CORTEX_M
	bool "ARM Cortex-M target & SoCs"
	select ARCH_ARM

config ARCH_RV32
	bool "RISC-V 32 bit target & SoCs"
	select ARCH_RISCV

endchoice

rsource 'asm-generic/Kconfig'

if ARCH_ARM_CORTEX_M
rsource 'asm-cortex-m/Kconfig'
endif

if ARCH_RV32
rsource 'asm-rv32/Kconfig'
endif

endmenu
```
