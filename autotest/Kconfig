## kernel/src/arch/asm-cortex-m/Kconfig
```kconfig
# SPDX-FileCopyrightText: 2023 Ledger SAS
# SPDX-License-Identifier: Apache-2.0

# masked symbols. These symbols are automatically selected based on the
# target SoC.
# The target SoC define the core technology, and thus the core features

menu "ARM configuration"

config ARCH_ARM_ARMV7M
	bool
	select HAS_NVIC
	select THUMB
	select HAS_DWT

config ARCH_ARM_ARMV7EM
	bool
	select ARCH_ARM_ARMV7M
	select HAS_DSP

config ARCH_ARM_ARMV8M
	bool
	select HAS_MPU
	select HAS_MPU_PMSA_V8
	select HAS_NVIC
	select THUMB
	select HAS_DWT

# ARMv8m-mainline
config ARCH_ARM_ARMV8MML
	bool
	select ARCH_ARM_ARMV8M
	select HAS_DSP
	select HAS_SIMD

config ARCH_ARM_CORTEX_M3
	bool
	select ARCH_ARM_ARMV7M

config ARCH_ARM_CORTEX_M4
	bool
	select ARCH_ARM_ARMV7EM

config ARCH_ARM_CORTEX_M7
	bool
	select ARCH_ARM_ARMV7EM
	select HAS_SIMD

config ARCH_ARM_CORTEX_M33
	bool
	select ARCH_ARM_ARMV8MML

config ARCH_ARM_CORTEX_M35P
	bool
	select ARCH_ARM_ARMV8MML

config HAS_FPU_VFPV3
	bool

config HAS_FPU_VFPV4
	bool

config HAS_FPU_FPV5
	bool

config HAS_MPU_PMSA_V7
	bool

config HAS_MPU_PMSA_V8
	bool

# TODO Add secure MPU feature

config HAS_TRUSTZONE
	bool

config HAS_NVIC
	bool

config THUMB
	bool

config HAS_FLASH_DUAL_BANK
	bool

config SOC_FAMILY_STM32
	bool
	select LITTLE_ENDIAN

config SOC_SUBFAMILY_STM32F4
	bool
	select ARCH_ARM_CORTEX_M4
	select SOC_FAMILY_STM32
	select HAS_FPU
	select HAS_FPU_VFPV4
	select HAS_MPU
	select HAS_DCACHE
	select HAS_ICACHE
	select HAS_MPU_PMSA_V7
	help
	  STM32F4 family is based on Cortex-M4 with FPU and PMSAv7 MPU.

config SOC_SUBFAMILY_STM32L4
	bool
	select ARCH_ARM_CORTEX_M4
	select SOC_FAMILY_STM32
	select HAS_FPU
	select HAS_FPU_VFPV4
	select HAS_MPU
	select HAS_MPU_PMSA_V7
	select HAS_DCACHE
	select HAS_ICACHE
	select HAS_RNG
	help
	  STM32L4 family is based on Cortex-M4 with FPU and PMSAv7 MPU with low power features

config SOC_SUBFAMILY_STM32U5
	bool
	select ARCH_ARM_CORTEX_M33
	select SOC_FAMILY_STM32
	select HAS_FPU
	select HAS_FPU_FPV5
	select HAS_TRUSTZONE
	select HAS_DCACHE
	select HAS_ICACHE
	select HAS_RNG
	select HAS_GPDMA
	help
	  STM32U5 family is based on Cortex-M33 with FPU, PMSAv8 MPU and TrustZone

config SOC_SUBFAMILY_STM32WB
	bool
	select ARCH_ARM_CORTEX_M4
	select SOC_FAMILY_STM32
	select HAS_FPU
	select HAS_MPU
	select HAS_RNG
	select HAS_MPU_PMSA_V7
	# Cache support ?
	help
	  STM32WB family is based on Cortex-M4 (main core and a Cortex-M0+ for wireless core)
	  Cortex-M0+ arch is not supported, only main core can be targetted.

# XXX STM32F401 does not have RNG !
config SOC_SUBFAMILY_STM32F4x5_7
	bool
	select HAS_RNG
	select SOC_SUBFAMILY_STM32F4

config SOC_SUBFAMILY_STM32F42_3xx
	bool
	select HAS_RNG
	select HAS_FLASH_DUAL_BANK
	select SOC_SUBFAMILY_STM32F4

config SOC_SUBFAMILY_STM32L47_8x
	bool
	select SOC_SUBFAMILY_STM32L4

config SOC_SUBFAMILY_STM32L49_Ax
	bool
	select SOC_SUBFAMILY_STM32L4

config SOC_SUBFAMILY_STM32U535_545
	bool
	select SOC_SUBFAMILY_STM32U5

config SOC_SUBFAMILY_STM32U575_585
	bool
	select SOC_SUBFAMILY_STM32U5

config SOC_SUBFAMILY_STM32U59_Ax
	bool
	select SOC_SUBFAMILY_STM32U5

config SOC_SUBFAMILY_STM32U5F_Gx
	bool
	select SOC_SUBFAMILY_STM32U5

config ARCH_ARM_CORTEX_NAME
	string
	default "m3" if ARCH_ARM_CORTEX_M3
	default "m4" if ARCH_ARM_CORTEX_M4
	default "m7" if ARCH_ARM_CORTEX_M7
	default "m33" if ARCH_ARM_CORTEX_M33
	default "m35p" if ARCH_ARM_CORTEX_M35P

config ARCH_SOCNAME
	string
	default "STM32WB55_CM4" if ARCH_MCU_STM32WB55_CM4
	default "STM32F401" if ARCH_MCU_STM32F401
	default "STM32F407" if ARCH_MCU_STM32F407
	default "STM32F419" if ARCH_MCU_STM32F419
	default "STM32F429" if ARCH_MCU_STM32F429
	default "STM32F439" if ARCH_MCU_STM32F439
	default "STM32L476" if ARCH_MCU_STM32L476
	default "STM32U534" if ARCH_MCU_STM32U534
	default "STM32U535" if ARCH_MCU_STM32U535
	default "STM32U545" if ARCH_MCU_STM32U545
	default "STM32U575" if ARCH_MCU_STM32U575
	default "STM32U585" if ARCH_MCU_STM32U585
	default "STM32U595" if ARCH_MCU_STM32U595
	default "STM32U599" if ARCH_MCU_STM32U599
	default "STM32U5A5" if ARCH_MCU_STM32U5A5
	default "STM32U5A9" if ARCH_MCU_STM32U5A9
	default "STM32U5FX" if ARCH_MCU_STM32U5FX
	default "STM32U5GX" if ARCH_MCU_STM32U5GX

# User-accessible selectors

choice
	bool "target SoC selection"
	default ARCH_MCU_STM32U599

config ARCH_MCU_STM32F439
	bool "STM32F439"
	select SOC_SUBFAMILY_STM32F42_3xx

config ARCH_MCU_STM32F429
	bool "STM32F429"
	select SOC_SUBFAMILY_STM32F42_3xx

config ARCH_MCU_STM32F407
	bool "STM32F407"
	select SOC_SUBFAMILY_STM32F4x5_7

config ARCH_MCU_STM32F401
	bool "STM32F401"
	select SOC_SUBFAMILY_STM32F4

config ARCH_MCU_STM32WB55_CM4
	bool "STM32WB55"
	select SOC_SUBFAMILY_STM32WB

config ARCH_MCU_STM32L476
	bool "STM32L476"
	select SOC_SUBFAMILY_STM32L47_8x

config ARCH_MCU_STM32U595
	bool "STM32U595"
	select SOC_SUBFAMILY_STM32U59_Ax

config ARCH_MCU_STM32U599
	bool "STM32U599"
	select SOC_SUBFAMILY_STM32U59_Ax

config ARCH_MCU_STM32U5A5
	bool "STM32U5A5"
	select SOC_SUBFAMILY_STM32U59_Ax

config ARCH_MCU_STM32U5A9
	bool "STM32U5A9"
	select SOC_SUBFAMILY_STM32U59_Ax

endchoice

if HAS_FPU

choice
	bool "floating point ABI"
config FPU_SOFT_ABI
	bool "soft"
config FPU_SOFTFP_ABI
	bool "soft-fp"
	depends on HAS_FPU
config FPU_HARDFP_ABI
	bool "hard-fp"
	depends on HAS_FPU
endchoice

config USE_FPU
	bool
	default y if FPU_HARDFP_ABI
	default y if FPU_SOFTFP_ABI

choice
	bool "FPv5 float precision"
	depends on HAS_FPU_FPV5
	help
	  Choose floating precision (single/double) to use for FPv5 floating point unit
	  FPV5 is the FPU revision for M7/M33/M35P arch.
	  Only Cortex-M7 can use Double precision (manufacturer defined, check your SoC
	  dreference manual).

config FPV5_SP
	bool "single precision"

config FPV5_DP
	bool "double precision"
	depends on ARCH_ARM_CORTEX_M7
endchoice

endif

config FPU_ABI_CFLAGS
	string
	default "-mfloat-abi=soft" if FPU_SOFT_ABI
	default "-mfloat-abi=softfp" if FPU_SOFTFP_ABI
	default "-mfloat-abi=hard" if FPU_HARDFP_ABI

config FPU_CFLAGS
	string
	depends on !FPU_SOFT_ABI
	depends on HAS_FPU && (HAS_FPU_VFPV3 || HAS_FPU_VFPV4 || HAS_FPU_FPV5)
	default "-mfpu=vfpv4-d16" if HAS_FPU_VFPV4
	default "-mfpu=fpv5-d16" if HAS_FPU_FPV5 && FPV5_DP
	default "-mfpu=fpv5-sp-d16" if HAS_FPU_FPV5 && FPV5_SP && !FPV5_DP

config ISA_CFLAGS
	string
	default "-mthumb" if THUMB

config RUSTC_TARGET
	string
	default "thumbv7m-none-eabi" if ARCH_ARM_ARMV7M && !ARCH_ARM_ARMV7EM
	default "thumbv7em-none-eabi" if ARCH_ARM_ARMV7EM && !FPU_HARDFP_ABI
	default "thumbv7em-none-eabihf" if ARCH_ARM_ARMV7EM && FPU_HARDFP_ABI
	default "thumbv8m.main-none-eabi" if ARCH_ARM_ARMV8MML && !FPU_HARDFP_ABI
	default "thumbv8m.main-none-eabihf" if ARCH_ARM_ARMV8MML && FPU_HARDFP_ABI

endmenu
```

## kernel/src/arch/asm-generic/Kconfig
```kconfig
# SPDX-FileCopyrightText: 2025 H2Lab Development Team
# SPDX-License-Identifier: Apache-2.0

# Endianess is not arch-specific, but is defined here for consistency
# with various arches, and to allow SoC-specific selection
config LITTLE_ENDIAN
	bool

config BIG_ENDIAN
	bool

# data and instruction caches are not mandatory, but are
# commonly found in most SoCs for various architectures
config HAS_DCACHE
	bool

config HAS_ICACHE
	bool

# Floating Point Unit (FPU) is not mandatory, but is
# commonly found in most SoCs for various architectures
config HAS_FPU
	bool

# raspberry pi Pico SoC family may be cortex-m or RISC-V based, and as such is
# selectable in both ARM and RISC-V modes
config SOC_FAMILY_RPI_PICO
	bool
	select LITTLE_ENDIAN
	select HAS_DCACHE
	select HAS_ICACHE
```

## kernel/src/arch/asm-rv32/Kconfig
```kconfig
# SPDX-FileCopyrightText: 2025 ANSSI
# SPDX-License-Identifier: Apache-2.0

menu "RISC-V configurations"

config SOC_SUBFAMILY_QEMURV32
  bool
  select HAS_DCACHE
  select HAS_ICACHE
  help
    Basic QEMU RISC-V virt platform

config SOC_SUBFAMILY_OPENTITAN
  bool
  select HAS_DCACHE
  select HAS_ICACHE
  help
    Basic QEMU RISC-V virt platform

config ARCH_SOCNAME
  string
  default "QEMU_RV32" if SOC_SUBFAMILY_QEMURV32
  default "OPENTITAN_EARLGREY" if SOC_SUBFAMILY_OPENTITAN

choice
  bool "target SoC selection"
  default ARCH_MCU_OPENTITAN

config ARCH_MCU_QEMURV32
  bool "QEMU_RV32"
  select SOC_SUBFAMILY_QEMURV32

config ARCH_MCU_OPENTITAN
  bool "OPENTITAN_EARLGREY"
  select SOC_SUBFAMILY_OPENTITAN

endchoice

config RUSTC_TARGET
	string
	default "riscv32imc-unknown-none-elf" if SOC_SUBFAMILY_OPENTITAN

endmenu
```

## kernel/src/drivers/Kconfig
```kconfig
# SPDX-FileCopyrightText: 2023-2024 Ledger SAS
# SPDX-License-Identifier: Apache-2.0

menu "Drivers"

rsource 'usart/Kconfig'

rsource 'smp/Kconfig'

endmenu
```

## kernel/src/drivers/smp/Kconfig
```kconfig
# SPDX-FileCopyrightText: 2025 H2Lab Development Team
# SPDX-License-Identifier: Apache-2.0

menu "SMP-related IPs (EXPERIMENTAL)"
	depends on WITH_SMP_SUPPORT

config HAS_SIO
	bool "RPi 2350 SIO for SMP cores"
	default n

endmenu
```

## kernel/src/drivers/usart/Kconfig
```kconfig
# SPDX-FileCopyrightText: 2025 ANSSI
# SPDX-License-Identifier: Apache-2.0

menu "ST USART"

rsource 'st/Kconfig'

endmenu
```

## kernel/src/drivers/usart/st/Kconfig
```kconfig
# SPDX-FileCopyrightText: 2023-2024 Ledger SAS
# SPDX-License-Identifier: Apache-2.0

menu "Usart"
	depends on DEBUG_OUTPUT_USART

choice
	bool "Debug USART driver selection"
	default DRV_STM32_USART


config DRV_STM32_USART
	bool "STM32_USART"
	depends on SOC_FAMILY_STM32

config DRV_STM32_LPUART
	bool "STM32_LPUART"
	depends on SOC_SUBFAMILY_STM32L4 || SOC_SUBFAMILY_STM32U5 || SOC_SUBFAMILY_STM32WB

endchoice

endmenu
```

## kernel/src/managers/Kconfig
```kconfig
# SPDX-FileCopyrightText: 2023-2024 Ledger SAS
# SPDX-License-Identifier: Apache-2.0

menu "Managers"

menu "Task manager"

config SVC_EXCHANGE_AREA_LEN
	int "Size of the SVC_Exchange area"
	range 64 1024
	default 128
	help
	  length (in bytes) of the user/kernel exchange area

config TASK_MAGIC
	hex "task magic"
	default 0xdeadcafe
	help
	  Default tasks magic to be set for all tasks. this value is specific to
	  each project so that when building tasks for a given project, only these
	  tasks can be added to the kernel bin.

config MAX_DEV_PER_TASK
	int "max devices per task"
	range 0 8
	default 4
	help
	  Maximum number of declared device per task

config MAX_SHM_PER_TASK
	int "Maximum mumber of SHM per task"
	range 0 8
	default 4
	help
	  Maximum number of owned shared memory per task

config MAX_DMA_STREAMS_PER_TASK
	int "Maximum mumber of DMA streams per task"
	range 0 8
	default 4
	help
      Maximum number of declared DMA streams per task

endmenu

if !BUILD_TARGET_RELEASE

menu "Debug manager"

choice
	bool "Debug output"
	default DEBUG_OUTPUT_USART
config DEBUG_OUTPUT_USART
	bool "using dts-configured usart as debug output"
config DEBUG_OUTPUT_SEMIHOSTING
	bool "using jtag ARM semihosting as output"
	depends on ARCH_ARM_CORTEX_M && WITH_JTAG_CONNECTED
config DEBUG_OUTPUT_NONE
	bool "using no log output"
endchoice

if DEBUG_OUTPUT_SEMIHOSTING

config DEBUG_SEMIHOSTING_OUTPUT_FILE
	string "semihosting Host filename to use"
	default "/tmp/fb_rot_log"
	help
	  Host filename to write log outputs to, in
	  semihosting mode

endif

if DEBUG_OUTPUT_USART

config DEBUG_COLORS
	bool "Support for ANSI colors support"
	default n
	help
	  Activate ANSI coloration on serial console for kernel debugging
	  output. Userspace log is not impacted

config DEBUG_LOGO
	bool "Display kernel logo on startup"
	default y
	help
	  Display the kernel logo on startup, if the console supports it.
	  This is only available for debug output on usart.

config DEBUG_LOGO_COLORED
	bool "Display kernel logo in color"
	default n
	help
	  Display the kernel logo in color, if the console supports it.
	  This is only available for debug output on usart.

if DEBUG_COLORS

choice
	bool "ANSI color mode"
	default DEBUG_COLORS_REGULAR
config DEBUG_COLORS_REGULAR
	bool "regular message highlighting"
	help
	  kernel messages are highighted using foreground color, regular mode
config DEBUG_COLORS_BOLD
	bool "bold message highlighting"
	help
	  kernel messages are highighted using foreground color, bold mode
config DEBUG_COLORS_BACKGROUND
	bool "background message highlighting"
	help
	  kernel messages are highighted using background color
endchoice

choice
	bool "Default text color"
	default DEBUG_COLOR_DEFAULT_WHITE
config DEBUG_COLOR_DEFAULT_WHITE
	bool "default text color to white"
config DEBUG_COLOR_DEFAULT_BLACK
	bool "default text color to black"
endchoice

endif

endif

config DEBUG_LEVEL
	int "kernel debug level"
	range 0 8
	default 7
	help
	  Kernel activated debug level, from 0 (no debug) upto 8 (all debug)
	  debug levels are the following:
	  - 0 : no debug
	  - 1 : emerg
	  - 2 : emerg, alert
	  - 3 : emerg, alert, critical
	  - 4 : emerg, alert, critical, error
	  - 5 : emerg, alert, critical, error, warning
	  - 6 : emerg, alert, critical, error, warning, notice
	  - 7 : emerg, alert, critical, error, warning, notice, info
	  - 8 : emerg, alert, critical, error, warning, notice, info, debug
	  autotest-specific logging is not impacted by debug level

endmenu

endif

menu "Security manager"

choice
	bool "Entropy source"
	default SECURITY_HW_ENTROPY if HAS_RNG
	default SECURITY_PGC32_ENTROPY if !HAS_RNG
	config SECURITY_HW_ENTROPY
		bool "Using HW RNG as entropy source"
		depends on HAS_RNG
	config SECURITY_PGC32_ENTROPY
		bool "Using PGC32 as entropy source"
endchoice

endmenu

endmenu
```

## kernel/src/startup/Kconfig
```kconfig
# SPDX-FileCopyrightText: 2023-2024 Ledger SAS
# SPDX-License-Identifier: Apache-2.0

menu "Core functions"

config MAX_TASKS
	int "Maximum number of userspace tasks"
	range 1 256
	default 8
	help
	  Maximum number of userspace tasks, from 1 to 256


choice
	bool "Scheduling policy"
	default SCHED_RRMQ
config SCHED_RRMQ
	bool "Round-Robin Multiqueue with Quantum scheduler policy"
	help
	  Schedule task with multiqueue round-robin, with elastic quantum support
	  Allows differenciated quantum per task, with timeslotting-based task sets
	  Highly efficient when well configured.
	  A task can yield() before its quantum end to refresh it. Blocking syscalls
	  (IPC, sleep) also refresh the quantum.
config SCHED_FIFO
	bool "FIFO-based policy"
	help
	  Schedule task with FIFO scheduling policy. Each task is executed
	  while not entering a blocking syscall (yield, sleep, etc.). The
	  task is eligible again each time an input event is received (IPC, signal,
	  interrupt)
config SCHED_RMA
	bool "Rate Monotonic Algorithm scheduler policy (EXPERIMENTAL)"
	help
	  Schedule tasks using the Rate Monotonic Algorithm (RMA), a fixed-priority
	  preemptive policy optimal for independent periodic task sets.
	  The task period is taken from the priority field of the task metadata:
	  a smaller value means a shorter period and therefore a higher scheduling
	  priority.  The quantum field is not used.
	  Tasks are re-activated at each period boundary; a task that blocks
	  (sleep, IPC wait, …) exits the ready set and is re-admitted only when
	  explicitly re-scheduled at wakeup time.

endchoice

config SCHED_NAME
	string
	default "RRMQ" if SCHED_RRMQ
	default "FIFO" if SCHED_FIFO
	default "RMA"  if SCHED_RMA

endmenu
```
